## boards/shields/ergonaut_one_dongle/Kconfig.shield
```kconfig
# Copyright (c) 2020 The ZMK Contributors
# SPDX-License-Identifier: MIT

config SHIELD_ERGONAUT_ONE_DONGLE_LEFT
    def_bool $(shields_list_contains,ergonaut_one_dongle_left)

config SHIELD_ERGONAUT_ONE_DONGLE_RIGHT
    def_bool $(shields_list_contains,ergonaut_one_dongle_right)

config SHIELD_ERGONAUT_ONE_DONGLE
    def_bool $(shields_list_contains,ergonaut_one_dongle)
```
